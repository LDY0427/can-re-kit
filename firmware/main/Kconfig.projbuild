## firmware/main/Kconfig.projbuild
```kconfig
menu "Stock CAN tool"
    choice CANTOOL_BOARD
        prompt "Board"
        default CANTOOL_BOARD_DEVKIT
        config CANTOOL_BOARD_DEVKIT
            bool "ESP32-S3 dev board + transceiver module (console UART0, 921600 baud)"
        config CANTOOL_BOARD_MODULE
            bool "Stock CAN tool board Rev.A0 (console USB Serial/JTAG on the USB-C port)"
    endchoice
endmenu
```

## firmware/sdkconfig.defaults
```kconfig
CONFIG_IDF_TARGET="esp32s3"
CONFIG_ESP_CONSOLE_UART_CUSTOM=y
CONFIG_ESP_CONSOLE_UART_BAUDRATE=921600
CONFIG_ESP_MAIN_TASK_STACK_SIZE=8192
CONFIG_FREERTOS_HZ=1000
CONFIG_LOG_DEFAULT_LEVEL_WARN=y
```
